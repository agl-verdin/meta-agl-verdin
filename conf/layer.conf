## conf/layer.conf
```bitbake
# We have a conf and classes directory, add to BBPATH
BBPATH .= ":${LAYERDIR}"

# We have recipes-* directories, add to BBFILES
BBFILES += "${LAYERDIR}/recipes-*/*/*.bb \
            ${LAYERDIR}/recipes-*/*/*.bbappend"

BBFILE_COLLECTIONS += "meta-agl-verdin"
BBFILE_PATTERN_meta-agl-verdin = "^${LAYERDIR}/"
BBFILE_PRIORITY_meta-agl-verdin = "80"

LAYERDEPENDS_meta-agl-verdin = "aglcore qt5-layer openembedded-layer"
LAYERSERIES_COMPAT_meta-agl-verdin = "kirkstone"
```
